#include "compat.hpp"

#include <avr/interrupt.h>
#include <util/delay_basic.h>

/**
 * @file compat_tick.cpp
 * @brief Базовый миллисекундный тикер и задержки для AVR.
 *
 * @details
 * Файл реализует:
 * - миллисекундный системный счётчик на Timer0;
 * - функцию hal::millis();
 * - функцию hal::delay();
 * - функцию hal::delayMicroseconds().
 *
 * Timer0 работает в режиме CTC:
 * - источник тактирования: F_CPU;
 * - предделитель: 64;
 * - OCR0A = 249;
 * - частота прерывания: 1000 Гц;
 * - период прерывания: 1 мс.
 *
 * Для F_CPU = 16000000UL расчёт:
 * F_CPU / 64 / (249 + 1) = 1000 Гц.
 *
 * @note
 * Этот файл является общей частью HAL и не содержит привязки к плате LDO.
 *
 * @warning
 * Timer0 используется системным тикером. Не следует использовать Timer0
 * для другой прикладной логики, ШИМ или независимых измерений времени
 * без пересмотра этой реализации.
 *
 * @warning
 * Реализация рассчитана на F_CPU = 16000000UL. Если частота микроконтроллера
 * отличается, нужно пересчитать предделитель и OCR0A.
 */

#if (F_CPU != 16000000UL)
#  warning "compat_tick.cpp is configured for F_CPU = 16000000UL. Check Timer0 settings."
#endif

/**
 * @brief Счётчик миллисекунд.
 *
 * @details
 * Инкрементируется в обработчике прерывания TIMER0_COMPA_vect.
 *
 * @note
 * Переменная имеет размер 32 бита. На восьмибитных AVR чтение такого значения
 * не является атомарным, поэтому доступ к нему выполняется через
 * atomic_read_millis().
 */
static volatile uint32_t s_millis = 0UL;

namespace
{
    /**
     * @brief Атомарно читает 32-битный счётчик миллисекунд.
     *
     * @return Текущее значение системного счётчика миллисекунд.
     *
     * @details
     * На восьмибитных AVR чтение uint32_t может быть прервано ISR посередине
     * операции. Поэтому функция кратковременно запрещает прерывания,
     * считывает значение и восстанавливает прежнее состояние регистра SREG.
     */
    static inline uint32_t atomic_read_millis(void)
    {
        const uint8_t old_sreg = SREG;

        cli();

        const uint32_t value = s_millis;

        SREG = old_sreg;

        return value;
    }
}

namespace hal
{
    /**
     * @brief Инициализирует миллисекундный системный тикер.
     *
     * @details
     * Настраивает Timer0:
     * - CTC mode;
     * - compare match по OCR0A;
     * - предделитель 64;
     * - частота прерывания 1000 Гц при F_CPU = 16000000UL.
     *
     * Обычно вызывается один раз из main() до setup().
     *
     * @post
     * После вызова становятся валидными:
     * - hal::millis();
     * - hal::delay();
     * - глобальная совместимая функция millis();
     * - глобальная совместимая функция delay().
     */
    void tick_init(void)
    {
        /*
         * Останавливаем Timer0 на время настройки.
         */
        TCCR0B = 0u;

        /*
         * Сбрасываем счётчик таймера.
         */
        TCNT0 = 0u;

        /*
         * Сбрасываем системный счётчик миллисекунд.
         */
        s_millis = 0UL;

        /*
         * CTC mode:
         * WGM01 = 1, WGM00 = 0.
         *
         * Compare outputs отключены, поэтому выводы OC0A/OC0B остаются
         * обычными GPIO. Для LDO это важно, так как PD5 и PD6 используются
         * как релейные выходы.
         */
        TCCR0A = static_cast<uint8_t>(_BV(WGM01));

        /*
         * OCR0A = 249:
         * 16000000 / 64 / (249 + 1) = 1000 Гц.
         */
        OCR0A = 249u;

        /*
         * Очищаем возможный pending-флаг compare match.
         * У AVR флаги в TIFR очищаются записью единицы.
         */
        TIFR0 = static_cast<uint8_t>(_BV(OCF0A));

        /*
         * Разрешаем прерывание по совпадению Timer0 Compare Match A.
         */
        TIMSK0 = static_cast<uint8_t>(_BV(OCIE0A));

        /*
         * Запускаем Timer0 с предделителем 64:
         * CS01 = 1, CS00 = 1.
         */
        TCCR0B = static_cast<uint8_t>(_BV(CS01) | _BV(CS00));
    }

    /**
     * @brief Возвращает время с момента инициализации системного тикера.
     *
     * @return Количество миллисекунд с момента вызова hal::tick_init().
     *
     * @details
     * Значение переполняется по модулю 2^32. Для проверки интервалов времени
     * нужно использовать вычитание беззнаковых значений:
     *
     * @code
     * if ((uint32_t)(millis() - start) >= period) {
     *     // period elapsed
     * }
     * @endcode
     */
    uint32_t millis(void)
    {
        return atomic_read_millis();
    }

    /**
     * @brief Выполняет блокирующую задержку в миллисекундах.
     *
     * @param ms Длительность задержки в миллисекундах.
     *
     * @details
     * Функция использует hal::millis() и корректно работает при переполнении
     * 32-битного счётчика времени.
     *
     * @warning
     * Функция блокирующая. Пока выполняется delay(), прикладной код не
     * обслуживает основной цикл. Прерывания при этом остаются включёнными,
     * если вызывающая сторона не запретила их заранее.
     */
    void delay(uint32_t ms)
    {
        const uint32_t start = millis();

        while (static_cast<uint32_t>(millis() - start) < ms)
        {
            /*
             * Busy-wait.
             */
        }
    }

    /**
     * @brief Выполняет приблизительную блокирующую задержку в микросекундах.
     *
     * @param us Длительность задержки в микросекундах.
     *
     * @details
     * Реализация использует _delay_loop_2().
     *
     * _delay_loop_2(N) занимает примерно 4 * N тактов процессора.
     * Для F_CPU = 16000000UL одна микросекунда соответствует примерно
     * 16 тактам, то есть N = 4.
     *
     * @note
     * Точность хуже на малых значениях us из-за накладных расходов цикла
     * и вызова функции. Для протокольных задержек уровня десятков и сотен
     * микросекунд этого обычно достаточно.
     */
    void delayMicroseconds(uint16_t us)
    {
        const uint16_t iters_per_us =
            static_cast<uint16_t>(F_CPU / 4000000UL);

        if (iters_per_us == 0u)
        {
            return;
        }

        while (us != 0u)
        {
            _delay_loop_2(iters_per_us);
            --us;
        }
    }
}

/**
 * @brief Обработчик прерывания Timer0 Compare Match A.
 *
 * @details
 * Вызывается с частотой 1000 Гц при F_CPU = 16000000UL.
 * Инкрементирует системный счётчик миллисекунд.
 */
ISR(TIMER0_COMPA_vect)
{
    ++s_millis;
}
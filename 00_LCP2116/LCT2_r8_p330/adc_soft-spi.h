// #define	ADC_QTY				3							// Количество АЦП.
#define	ADC_RES				12							// Разрешение АЦП, бит.
#define	ADC_SMPLS			1							// Количество оцифровок за один вызов.
// #define	ADC_PAUSE			10							// Пауза между оцифровками, мкс.
// #define	ADC_SETS			1							// Количество "наборов" АЦП. Один набор может содержать до 8-и АЦП (по количеству входов одного порта МК).
#define ADC_CT_MASK			0b00000111

#define ADC_CS_LOW			set_pin_low(PORT_ADC_CS, ADC_CS)
#define ADC_CS_HIGH			set_pin_high(PORT_ADC_CS, ADC_CS)
#define ADC_CLOCK			set_pin_high(PORT_ADC_CLK, ADC_CLK); set_pin_low(PORT_ADC_CLK, ADC_CLK)
#define ADC_CT1_GAIN_ON		set_pin_high(PORT_ADC_CT1_GAIN, ADC_CT1_GAIN)
#define ADC_CT1_GAIN_OFF	set_pin_low(PORT_ADC_CT1_GAIN, ADC_CT1_GAIN)
#define ADC_CT2_GAIN_ON		set_pin_high(PORT_ADC_CT2_GAIN, ADC_CT2_GAIN)
#define ADC_CT2_GAIN_OFF	set_pin_low(PORT_ADC_CT2_GAIN, ADC_CT2_GAIN)
#define ADC_CT3_GAIN_ON		set_pin_high(PORT_ADC_CT3_GAIN, ADC_CT3_GAIN)
#define ADC_CT3_GAIN_OFF	set_pin_low(PORT_ADC_CT3_GAIN, ADC_CT3_GAIN)


enum adc{
	ADC_CT_1,
	ADC_CT_2,
	ADC_CT_3,
	ADC_1 = 0,
	ADC_2,
	ADC_3,
	ADC_4,
	ADC_5,
	ADC_6,
	ADC_7,
	ADC_8,
	ADC_9,
};


// Буферы для хранения выборок АЦП:
u8	buf_ct[ADC_RES]	= {0};								// Буфер на 1 выборку с нужным разрешением АЦП.
u16	buf_ai[ADC_RES]	= {0};								// Двойной буфер (т.к. аналоговых входов 9, т.е. больше 8) на 1 выборку с нужным разрешением АЦП.
u16	buf_tmp[1]		= {0};
// u16 buf_adc1[ADC_SMPLS] = {0};
// u16 buf_adc2[ADC_SMPLS] = {0};
// u16 buf_adc3[ADC_SMPLS] = {0};


// Ф-ция считывает одну выборку со всех трёх АЦП ТТ и сохраняет её в переданный буфер.
void adc_ct_rec(u8 buffer[])
{
	u8 * ptr = buffer;
		ADC_CS_LOW;										// АЦП начинает преобразование по спаду сигнала CS.

		ADC_CLOCK;										// Согласно документации,
		ADC_CLOCK;										// сначала идут три нулевых бита,
		ADC_CLOCK;										// их пропускаем.

		for (u8 bit = 0; bit < ADC_RES; bit++){			// Цикл согласно разрядности АЦП.
			ADC_CLOCK;									// Подаём на АЦП тактовый импульс для приёма бита.
			*ptr = PIN_ADC_CT;							// Сохраняем текущий бит всей группы АЦП.
			ptr++;										// Передвигаем указатель на следующий байт.
		};

		ADC_CLOCK;										// Полная передача занимает 16 тактов (3 + 12 + 1).

		ADC_CS_HIGH;									// Возвращаем сигнал CS  обратно в HIGH.

		ADC_CLOCK;										// Минимальная пауза до следующего преобразования
		ADC_CLOCK;										// (перевода CS снова в LOW) составляет 4 такта CLK.
		ADC_CLOCK;										//
		ADC_CLOCK;										//
}

// Ф-ция считывает одну выборку со всех девяти АЦП аналогового входа.
void adc_ai_rec(u8 buffer[])
{
	u8 * ptr = buffer;
	ADC_CS_LOW;										// АЦП начинает преобразование по спаду сигнала CS.

	ADC_CLOCK;										// Согласно документации,
	ADC_CLOCK;										// сначала идут три нулевых бита,
	ADC_CLOCK;										// их пропускаем.

	for (u8 bit = 0; bit < ADC_RES; bit++){			// Цикл согласно разрядности АЦП.
		ADC_CLOCK;									// Подаём на АЦП тактовый импульс для приёма бита.
		*ptr = PIN_ADC_AI1;							// Сохраняем текущий бит 1-й группы (АЦП с 1 по 8).
		ptr++;										// Передвигаем указатель на следующий байт.
		*ptr = PIN_ADC_AI2;							// Сохраняем текущий бит 2-й группы (9-й АЦП).
		ptr++;										// Передвигаем указатель на следующий байт.
	};

	ADC_CLOCK;										// Полная передача занимает 16 тактов (3 + 12 + 1).

	ADC_CS_HIGH;									// Возвращаем сигнал CS  обратно в HIGH.

	ADC_CLOCK;										// Минимальная пауза до следующего преобразования
	ADC_CLOCK;										// (перевода CS снова в LOW) составляет 4 такта CLK.
	ADC_CLOCK;										//
	ADC_CLOCK;										//
}


// Ф-ция вычленяет из buf_src smpl_qty значений для АЦП с номером adc_id.
void adc_ct_extract(u8 buf_src[], u16 buf_dst[], u8 adc_id, u8 smpl_qty)
{

	u8*	ptr_src		= (u8 *) buf_src;
// 	u8*	ptr_dst		= (u8 *) buf_dst;
	u8	adc_mask	= 0;
	bit_set(adc_mask, adc_id);

	for (u8 smpl = 0; smpl < smpl_qty; smpl++){			// Перебираем по очереди все выборки.

		u16 adc_tmp = 0;								// Переменная-аккумулятор для формирования конечной выборки одного АЦП.

		for (u8 bit = 0; bit < 8; bit++){				// Цикл для получения первых 8-и бит одной выборки конкретного АЦП.
			if (*ptr_src & adc_mask){					// Если нужный нам бит равен "1"...
				adc_tmp++;								// ..то записываем "1" в младший бит "аккумулятора"...
			};
			adc_tmp <<= 1;								// ...и/или сдвигаем всё значение влево на единицу.
			ptr_src++;									// Перемещаем указатель на следующий "бит" текущей выборки.
		};

		for (u8 bit = 0; bit < (ADC_RES - 8); bit++){	// Цикл для получения оставшихся бит одной выборки конкретного АЦП.
			if (*ptr_src & adc_mask){					// Если нужный нам бит равен "1"...
				adc_tmp++;								// ..то записываем "1" в младший бит "аккумулятора"...
			};
			adc_tmp <<= 1;								// ...и/или сдвигаем всё значение влево на единицу.
			ptr_src++;									// Перемещаем указатель на следующий "бит" текущей выборки.
		};

		adc_tmp >>= 1;									// Отменяем последний сдвиг, т.к. никакого следующего бита уже не будет.
		buf_dst[smpl] = adc_tmp;						// Сохраняем получившийся результат в массив выборок конкретного АЦП.
	};
}





/*

// Ф-ция вычленяет из общего буфера buf_rec[] значения конкретного АЦП и сохраняет их в переданный буфер.
void adc_rearrange(u16 buffer[], u8 adc_id){

	u8 * ptr_src = (u8 *)&buf_rec;						// Указатель на первый байт общего массива выборок всех АЦП buf_rec[].
	u8 adc_mask = 0;									// Битовая маска конкретного АЦП в общей выборке.
	bit_set(adc_mask, adc_id);							// Включаем в маске бит интересующего нас АЦП.

  	for (u8 smpl = 0; smpl < ADC_SMPLS; smpl++){		// Перебираем по очереди все выбороки.

		u16 adc_tmp = 0;								// Переменная-аккумулятор для формирования конечной выборки одного АЦП.

 		for (u8 bit = 0; bit < 8; bit++){				// Цикл для получения первых 8-и бит одной выборки конкретного АЦП.
 			if (*ptr_src & adc_mask){					// Если нужный нам бит равен "1"...
 				adc_tmp++;								// ..то записываем "1" в младший бит "аккумулятора"...
 			};
			adc_tmp <<= 1;								// ...и/или сдвигаем всё значение влево на единицу.
			ptr_src+=2;									// Перемещаем указатель на следующий "бит" текущей выборки.
 		};

 		for (u8 bit = 0; bit < (ADC_RES - 8); bit++){	// Цикл для получения оставшихся бит одной выборки конкретного АЦП.
	 		if (*ptr_src & adc_mask){					// Если нужный нам бит равен "1"...
		 		adc_tmp++;								// ..то записываем "1" в младший бит "аккумулятора"...
	 		};
	 		adc_tmp <<= 1;								// ...и/или сдвигаем всё значение влево на единицу.
	 		ptr_src+=2;									// Перемещаем указатель на следующий "бит" текущей выборки.
 		};
 		adc_tmp >>= 1;									// Отменяем последний сдвиг, т.к. никакого следующего бита уже не будет.
		buffer[smpl] = adc_tmp;							// Сохраняем получившийся результат в массив выборок конкретного АЦП.
	};
};

*/


/*
// Ф-ция получает N выборок со всх АЦП и сохраняет их в общем буфере buf_rec[].
void volatile adc_recording(){
	u8 * ptr = (u8 *)&buf_rec;							// Указатель на первый байт общего массива выборок всех АЦП buf_rec[].

	for (u8 smpl = 0; smpl < ADC_SMPLS; smpl++){		// Цикл по количеству выборок.
		ADC_CS_LOW;										// АЦП начинает преобразование по спаду сигнала CS.

		adc_clock();									// Сначала идут три нулевых бита, их пропускаем.
		adc_clock();									//
		adc_clock();									//

		for (u8 bit = 0; bit < ADC_RES; bit++){			// Цикл согласно разрядности АЦП.
			adc_clock();								// Подаём на АЦП тактовый импульс для приёма бита.
			*ptr = PIN_ADC_SET1;						// Сохраняем текущий бит 1-й группы АЦП.
			ptr++;										// Передвигаем указатель на следующий байт.
			#ifdef PIN_ADC_SET2							// Если наборов АЦП два (больше восьми АЦП), то...
			*ptr = PIN_ADC_SET2;						// ...сохраняем текущий бит с 2-й группы АЦП и...
			#endif
 			ptr++;										// ...передвигаем указатель на следующий байт.
		};

		adc_clock();									// Полная передача занимает 16 тактов (3 + 12 + 1).

		ADC_CS_HIGH;									// Возвращаем сигнал CS  обратно в HIGH.

		adc_clock();									// Минимальная пауза до следующего преобразования
		adc_clock();									// (перевода CS снова в LOW) составляет 4 такта CLK.
		adc_clock();									//
		adc_clock();									//
// 		_delay_us(ADC_PAUSE);							// Пауза между выборками (опционально).
	};
};

*/